/*
 * fds185.c
 *
 * Created: 15-5-2014 19:51:24
 *  Author: Marc
 */ 

/*

connecties:

Schuifregister:

strobe: PB0
clock: PB5 (SCK)
data: PB3 (MOSI)
enable: PB1 (met weerstand naar VCC)

Rowselect:
A: PC0
B: PC1
C: PC2
U3 CS: PC3
U6 CS: PC4

*/

#define F_CPU 16000000UL

#include <avr/io.h>
#include <avr/interrupt.h>
#include <avr/wdt.h> 
#include <avr/pgmspace.h>

#include <util/delay.h>

#include <stdio.h>
#include <string.h>

#define SHIFTSIZE 480

volatile uint8_t shiftbuffer[SHIFTSIZE];

void init(void)
{      
  //Rowselect
  DDRC |= _BV(PC0) | _BV(PC1) | _BV(PC2) | _BV(PC3) | _BV(PC4);
    
  //disable output
  PORTB |= _BV(PB1);

  //SPI
  PORTB |= _BV(PB2);
  DDRB |= _BV(PB0) | _BV(PB1) | _BV(PB3) | _BV(PB5);
  SPCR |= _BV(SPE) | _BV(MSTR);
  SPSR |= _BV(SPI2X);
  
  //Timer  
  TCCR0A |= _BV(WGM01); //CTC
  TCCR0B |= _BV(CS00) | _BV(CS02); // CLK/1024
  TIMSK0 |= _BV(OCIE0A); //Enable interrupt  
  
  //OCR0A = 0x03; //4000Hz (250Hz full frame refresh)
  //OCR0A = 0x06; //2400Hz (150Hz full frame refresh)
  OCR0A = 0x09; //1600Hz (100Hz full frame refresh)
  //OCR0A = 0x0C; //1200Hz (75Hz full frame refresh)
  //OCR0A = 0x13; //800Hz (50Hz full frame refresh)
  //OCR0A = 0x26; //400Hz (25Hz full frame refresh)
  //OCR0A = 0x4D; //200Hz (12.5Hz full frame refresh)
  
  for(uint16_t i=0;i<SHIFTSIZE;i++)
    shiftbuffer[i] = 0x00;
  
  sei();
}

//rij 0-15
void rowSelect(uint8_t row)
{
  PORTC &= ~_BV(PC0) & ~_BV(PC1) & ~_BV(PC2) & ~_BV(PC3) & ~_BV(PC4);
  
  row = 7 - row;
  
  if (row <= 7)
    PORTC |= _BV(PC3) | (row & 0x07);
  else
    PORTC |= _BV(PC4) | (row & 0x07);
}

ISR(TIMER0_COMPA_vect)
{
  static uint8_t x, y=0, z;
  
  PORTB |= _BV(PB1);	//Disable output.
  //_delay_us(5);
  
  rowSelect(y);
    
  for(z=0;z<5;z++)
    for(x=0;x<6;x++)
    {
      SPDR=shiftbuffer[x+(y*6)+(z*96)];
      loop_until_bit_is_set(SPSR, SPIF);
    }
    
  PORTB |= _BV(PB0);  
  PORTB &= ~_BV(PB0);          
  
  y++;
  if(y==16)
    y=0;
  
  //_delay_us(5);
  PORTB &= ~_BV(PB1);	//Enable output.
}

void setpixel(uint8_t x, uint8_t y, uint8_t color)
{
  uint16_t pixel = y*48+x;
  uint16_t byte = pixel/8;
  uint8_t bit = x%8;
  
  if (color)
    shiftbuffer[byte] |= _BV(7-bit);
  else
    shiftbuffer[byte] &= ~_BV(7-bit);
}

void GLCD_Circle(unsigned char cx, unsigned char cy ,unsigned char radius, uint8_t color)
{
  int x, y, xchange, ychange, radiusError;
  x = radius;
  y = 0;
  xchange = 1 - 2 * radius;
  ychange = 1;
  radiusError = 0;
  while(x >= y)
  {
    setpixel(cx+x, cy+y, color);
    setpixel(cx-x, cy+y, color);
    setpixel(cx-x, cy-y, color);
    setpixel(cx+x, cy-y, color);
    setpixel(cx+y, cy+x, color);
    setpixel(cx-y, cy+x, color);
    setpixel(cx-y, cy-x, color);
    setpixel(cx+y, cy-x, color);
    y++;
    radiusError += ychange;
    ychange += 2;
    if ( 2*radiusError + xchange > 0 )
    {
      x--;
      radiusError += xchange;
      xchange += 2;
    }
  }
}

const char picture[] PROGMEM = {
  0b11111111, 0b11111111, 0b11111111, 0b11111111, 0b11111111, 0b11111111,
  0b10000000, 0b00000000, 0b00000000, 0b00000000, 0b00000000, 0b00000001,
  0b10000000, 0b00000000, 0b00000000, 0b00000000, 0b00000000, 0b00000001,
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  0b11111111, 0b11111111, 0b11111111, 0b11111111, 0b11111111, 0b11111111,
};

int main(void)
{ 
  wdt_enable(WDTO_1S);
  
  //wait for reprogramming 
  _delay_ms(250);
  
  //LED flash
  DDRB |= _BV(PB5);
  PORTB |= _BV(PB5);
  _delay_ms(250);
  PORTB &= ~_BV(PB5);
  
  init();
  
  uint8_t x, y, z;
  

  uint16_t b;
  for(b=0;b<sizeof(picture);b++)
    shiftbuffer[b] = pgm_read_byte(&picture[b]);
  
  /*
  for(x=0;x<8;x++)
    setpixel(4+x, 0, 1);
    
  for(x=0;x<8;x++)
    setpixel(24, x, 1);
       
  for(x=0;x<8;x++)
    setpixel(x, 10, 1);

  for(x=0;x<8;x++)
    setpixel(8+x, 8+x, 1);
  */
    
  x=12;
  y=2;
  z=5;
  uint8_t dir1 = 0, dir2 = 0, dir3 = 0;
  
    
  for(;;)  
  {
    wdt_reset();
    
    GLCD_Circle(23, 55, x, 1);
    GLCD_Circle(36, 40, y, 1);
    GLCD_Circle(12, 35, z, 1);
    _delay_ms(30);
    GLCD_Circle(23, 55, x, 0);
    GLCD_Circle(36, 40, y, 0);
    GLCD_Circle(12, 35, z, 0);
    
    if (dir1==0)
    {
      x++;
      if (x==22)
        dir1=1;
    }
    else
    {
      x--;
      if (x==1)
        dir1=0;
    }        
    
    if (dir2==0)
    {
      y++;
      if (y==5)
        dir2=1;
    }
    else
    {
      y--;
      if (y==1)
        dir2=0;
    }        
    
    if (dir3==0)
    {
      z++;
      if (z==11)
        dir3=1;
    }
    else
    {
      z--;
      if (z==1)
        dir3=0;
    }        
    
  }
}